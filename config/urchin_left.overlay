&kscan0 {
    row-gpios
        = <&pro_micro 6 (GPIO_ACTIVE_HIGH | GPIO_PULL_DOWN)> // ROW0
        , <&pro_micro 7 (GPIO_ACTIVE_HIGH | GPIO_PULL_DOWN)> // ROW1
        , <&pro_micro 8 (GPIO_ACTIVE_HIGH | GPIO_PULL_DOWN)> // ROW2
        , <&gpio1 1 (GPIO_ACTIVE_HIGH | GPIO_PULL_DOWN)>     // ROW3 - was &pro_micro 9 (P1.06), rewired to P1.01
        ;
};
